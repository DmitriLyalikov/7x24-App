## components/GR2048/Kconfig.projbuild
```kconfig
menu "GR2048 Flow Rate Sensor Driver Config"
    config FLOW_RATE_PIN
        int "GPIO Pin assignment for GR2048 IRQ reading"
        default 21
        help
            See project READMe.MD for instructions on pin assignment
endmenu
```

## components/L298N/Kconfig.projBuild
```kconfig
menu "L298N Configuration"
    config SERVO0_IN1_GPIO
        int "Servo GPIO 1"
        range 0 34
        default 32
        help 
            GPIO number (IOxx)
    config SERVO0_IN2_GPIO
        int "Servo GPIO 2"
        range 0 34
        default 33
    config SERVO0_ENABLE_GPIO
        int "Servo Enable GPIO"
        range 0 34
        default 25
endmenu
```

## components/LM35/Kconfig.projbuild
```kconfig
menu "LM35 Temperature Sensor Driver Config"
    config NO_OF_SAMPLES
        int "Integer Number of temperature samples to take in a single period"
        default 10
        help
            See project READMe.MD for instructions

    config SAMPLE_PERIOD
        int "Integer Number of milliseconds between writing to queue"
        default 12000
        help
            See project READMe.MD for instructions
endmenu
```

## components/pid_controller/Kconfig.projBuild
```kconfig
menu "PID Control Algorithm Configuration"
    config SET_TEMP
        int "Temperature Set point (Desired Value) in Celsius"
        default 30
        help
            See project READMe.MD for instructions

    config PID_CONTROL_PERIOD
        int "Period in Milliseconds for vPIDCompute task to compute a new value"
        default 12000
        help
            See project READMe.MD for instructions

    config PID_MIN_INTEGRAL
        int "PID Algorithm Minimum Integral Value"
        default 2
        help
            See project READMe.MD for instructions on setting PID tuning values

    config PID_MAX_INTEGRAL
        int "PID Algorithm Maximum Integral Value"
        default 10
        help
            See project READMe.MD for instructions on setting PID tuning values   

    config PID_EPSILON
        int "PID Algorithm Epsilon Value"
        default 1
        help
            See project READMe.MD for instructions on setting PID tuning values

    config PID_KP
        int "PID Algorithm Proportional Constant"
        default 2
        help
            See project READMe.MD for instructions on setting PID tuning values

    config PID_KI
        int "PID Algorithm Integral Constant"
        default 5
        help
            See project READMe.MD for instructions on setting PID tuning values

    config PID_KD
        int "PID Algorithm Derivative Constant"
        default 1
        help
            See project READMe.MD for instructions on setting PID tuning values
endmenu
```

## main/Kconfig.projbuild
```kconfig
menu "esp32-i2c-lcd1602 Configuration"

    config I2C_MASTER_SCL
        int "I2C Master SCL GPIO number"
        range 0 34
        default 19
        help
            GPIO number (IOxx) for I2C SCL.
    
            Some GPIOs are used for other purposes (flash connections, etc.) and cannot be used.
    
            GPIOs 35-39 are input-only so cannot be used to drive the One Wire Bus.
    
    config I2C_MASTER_SDA
        int "I2C Master SDA GPIO number"
        range 0 34
        default 18
        help
            GPIO number (IOxx) for I2C SDA.
    
            Some GPIOs are used for other purposes (flash connections, etc.) and cannot be used.
    
            GPIOs 35-39 are input-only so cannot be used to drive the One Wire Bus.
    
    config LCD1602_I2C_ADDRESS
        hex "I2C Address for LCD1602 device"
        default 0x27
        help
            I2C address for HD44780-compatible LCD1602 device.

    config EXAMPLE_WIFI_SSID
        string "WiFi SSID"
        default "JasperNet"
        help
            SSID (network name) for the example to connect to.

    config EXAMPLE_VALIDATE_SERVER_CERT
        bool "Validate server"
        default y
        help
            Validate the servers' certificate using CA cert.

    choice
        prompt "EAP method for the example to use"
        default EXAMPLE_EAP_METHOD_PEAP
        config EXAMPLE_EAP_METHOD_TLS
            bool "TLS"
        config EXAMPLE_EAP_METHOD_PEAP
            bool "PEAP"
        config EXAMPLE_EAP_METHOD_TTLS
            bool "TTLS"
    endchoice

    config EXAMPLE_EAP_METHOD
        int
        default 0 if EXAMPLE_EAP_METHOD_TLS
        default 1 if EXAMPLE_EAP_METHOD_PEAP
        default 2 if EXAMPLE_EAP_METHOD_TTLS

    config EXAMPLE_EAP_ID
        string "EAP ID"
        default "dlyalikov01@manhattan.edu"
        help
            Identity in phase 1 of EAP procedure.

    config EXAMPLE_EAP_USERNAME
        string "EAP USERNAME"
        depends on EXAMPLE_EAP_METHOD_PEAP || EXAMPLE_EAP_METHOD_TTLS
        default "Dlyalikov01"
        help
            Username for EAP method (PEAP and TTLS).

    config EXAMPLE_EAP_PASSWORD
        string "EAP PASSWORD"
        depends on EXAMPLE_EAP_METHOD_PEAP || EXAMPLE_EAP_METHOD_TTLS
        default "Mchp4ung!!"
        help
            Password for EAP method (PEAP and TTLS).
    
    endmenu
```
